## conf/layer.conf
```bitbake
# We have a conf and classes directory, add to BBPATH
BBPATH .= ":${LAYERDIR}"

# We have recipes-* directories, add to BBFILES
BBFILES += "${LAYERDIR}/recipes-*/*/*.bb  \
            ${LAYERDIR}/recipes-*/*/*.bbappend \
           "

BBFILE_COLLECTIONS += "meta-whisper"
BBFILE_PATTERN_meta-whisper = "^${LAYERDIR}/"
BBFILE_PRIORITY_meta-whisper = "6"

LAYERDEPENDS_meta-whisper = "core"
LAYERSERIES_COMPAT_meta-whisper = "scarthgap"

# add ISSL license
LICENSE_PATH += "${LAYERDIR}/licenses"

# add EULA license
CUSTOM_LICENSES_PATH = "${LAYERDIR}/licenses"
LICENSE_PATH += "${CUSTOM_LICENSES_PATH}"
```
